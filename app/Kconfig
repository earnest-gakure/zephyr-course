## app/Kconfig
```kconfig
mainmenu "LED Blink Application"

menu "LED Subsystem"

choice
    prompt "LED blink speed"
    default BLINK_SLEEP_1000MS


config BLINK_SLEEP_250MS
    bool "fast"

config BLINK_SLEEP_500MS
    bool "normal"

config BLINK_SLEEP_1000MS
    bool "medium"

config BLINK_SLEEP_2000MS
    bool "slow"

endchoice

config BLINK_SLEEP_TIME_MS
    int
    default 250 if BLINK_SLEEP_250MS
    default 500 if BLINK_SLEEP_500MS
    default 1000 if BLINK_SLEEP_1000MS
    default 2000 if BLINK_SLEEP_2000MS
  

menuconfig LED_ADVANCED
    bool "Advanced LED settings --->"

if LED_ADVANCED

config LED_BRIGHTNESS
    int "LED brightness (0-100)"
    range 0 100
    default 100

config LED_FADE_DURATION
    int "LED fade duration (ms)"
    range 0 5000
    default 500

menu "Expert settings --->"
    visible if LED_ADVANCED

config LED_ENABLE_DEBUGGING
    bool "Enable LED debugging"

config LED_CUSTOM_BLINK_PATTERN
    bool "Custom blink pattern"

endmenu

endif

endmenu

config APP_HEARTBEAT_PERIOD_MS
	int "Heartbeat LED period (ms)"
	default 500
	range 100 2000

source "Kconfig.zephyr"
```

## boards/raspberrypi/my_pico/Kconfig.my_pico
```kconfig
# Copyright (c) 2021 Yonatan Schachter
# SPDX-License-Identifier: Apache-2.0

config BOARD_MY_PICO
	bool
	select SOC_RP2040
```

## boards/raspberrypi/my_pico_scratch/Kconfig
```kconfig
# Copyright (c) 2021 Yonatan Schachter
# SPDX-License-Identifier: Apache-2.0

config BOARD_MY_PICO_SCRATCH
	select RP2_FLASH_W25Q080

source "boards/Kconfig.v2"
```

## boards/raspberrypi/my_pico_scratch/Kconfig.defconfig
```kconfig
# Copyright (c) 2021 Yonatan Schachter
# SPDX-License-Identifier: Apache-2.0

if BOARD_MY_PICO_SCRATCH

config USB_SELF_POWERED
	default n

endif # BOARD_MY_PICO_SCRATCH
```
